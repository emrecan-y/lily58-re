## boards/shields/lily58_re/Kconfig.shield
```kconfig
# Copyright (c) 2020 Pete Johanson
# SPDX-License-Identifier: MIT

config SHIELD_LILY58_RE_LEFT
    def_bool $(shields_list_contains,lily58_re_left)

config SHIELD_LILY58_RE_RIGHT
    def_bool $(shields_list_contains,lily58_re_right)
```
